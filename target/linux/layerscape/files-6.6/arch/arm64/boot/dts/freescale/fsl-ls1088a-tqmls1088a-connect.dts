/dts-v1/;

#include "fsl-ls1088a-tqmls1088a.dtsi"
#include "tqmls10xxa-connect.dtsi"

/ {
	model = "TQMLS1088A SoM on Moment Flymingo Connect board";
	compatible = "moment,ls1088a-tqmls1088a-connect", "tq,ls1088a-tqmls1088a", "fsl,ls1088a";

	aliases {
		serial0 = &duart0;
		serial1 = &duart1;
		serial2 = &duart2;
		serial3 = &duart3;
	};

	chosen {
		stdout-path = "serial1:115200n8";
	};
};

#include "tqmls1088a-connect-mc.dtsi"
